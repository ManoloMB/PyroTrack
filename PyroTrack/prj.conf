## CMakeLists.txt
```
# SPDX-License-Identifier: Apache-2.0

cmake_minimum_required(VERSION 3.20.0)

find_package(Zephyr REQUIRED HINTS $ENV{ZEPHYR_BASE})
project(PyroTrack)

FILE(GLOB app_sources src/*.c)
FILE(GLOB lib_sources src/lib_sensirion/*.c)

target_sources(app PRIVATE 
    ${app_sources}
    ${lib_sources}
)
```

## prj.conf
```kconfig
# nothing here

CONFIG_I2C=y
CONFIG_CBPRINTF_FP_SUPPORT=y
CONFIG_USE_SEGGER_RTT=y
CONFIG_RTT_CONSOLE=y
#CONFIG_UART_CONSOLE=n
CONFIG_BT=y
CONFIG_BT_DEBUG_LOG=y
CONFIG_BT_SMP=y
CONFIG_BT_PERIPHERAL=y
CONFIG_BT_DIS=y
CONFIG_BT_DIS_PNP=n
CONFIG_BT_BAS=y
CONFIG_BT_DEVICE_NAME="PyroTrack"
CONFIG_BT_DEVICE_APPEARANCE=768
CONFIG_BT_ATT_ENFORCE_FLOW=n
```

## src/main.c
```c
/*
 * Copyright (c) 2012-2014 Wind River Systems, Inc.
 *
 * SPDX-License-Identifier: Apache-2.0
 */

#include <zephyr/kernel.h>
#include <zephyr/drivers/i2c.h>
#include "lib_sensirion/svm41_i2c.h"

#include <zephyr/types.h>
#include <stddef.h>
#include <string.h>
#include <errno.h>
#include <zephyr/sys/printk.h>
#include <zephyr/sys/byteorder.h>

#include <zephyr/bluetooth/bluetooth.h>
#include <zephyr/bluetooth/hci.h>
#include <zephyr/bluetooth/conn.h>
#include <zephyr/bluetooth/uuid.h>
#include <zephyr/bluetooth/gatt.h>
#include <zephyr/bluetooth/services/bas.h>

#include "temp.h"
#include "hum.h"
#include "voc.h"
#include "nox.h"
#include "fire.h"

static const struct bt_data ad[] = {
    BT_DATA_BYTES(BT_DATA_FLAGS, (BT_LE_AD_GENERAL | BT_LE_AD_NO_BREDR)),
    BT_DATA_BYTES(BT_DATA_UUID16_ALL,
                  BT_UUID_16_ENCODE(BT_UUID_HTS_VAL),
                  BT_UUID_16_ENCODE(BT_UUID_DIS_VAL),
                  BT_UUID_16_ENCODE(BT_UUID_BAS_VAL)),
};

static void connected(struct bt_conn *conn, uint8_t err)
{
    if (err)
    {
        printk("Connection failed (err 0x%02x)\n", err);
    }
    else
    {
        printk("Connected\n");
    }
}

static void disconnected(struct bt_conn *conn, uint8_t reason)
{
    printk("Disconnected (reason 0x%02x)\n", reason);
}

BT_CONN_CB_DEFINE(conn_callbacks) = {
    .connected = connected,
    .disconnected = disconnected,
};

static void bt_ready(void)
{
    int err;

    printk("Bluetooth initialized\n");

    // hts_init();
    temp_init();
    hum_init();
    voc_init();
    nox_init();
    fire_init();

    err = bt_le_adv_start(BT_LE_ADV_CONN_NAME, ad, ARRAY_SIZE(ad), NULL, 0);
    if (err)
    {
        printk("Advertising failed to start (err %d)\n", err);
        return;
    }

    printk("Advertising successfully started\n");
}

static void auth_cancel(struct bt_conn *conn)
{
    char addr[BT_ADDR_LE_STR_LEN];

    bt_addr_le_to_str(bt_conn_get_dst(conn), addr, sizeof(addr));

    printk("Pairing cancelled: %s\n", addr);
}

static struct bt_conn_auth_cb auth_cb_display = {
    .cancel = auth_cancel,
};

static void bas_notify(void)
{
    uint8_t battery_level = bt_bas_get_battery_level();

    battery_level--;

    if (!battery_level)
    {
        battery_level = 100U;
    }

    bt_bas_set_battery_level(battery_level);
}

void main(void)
{
    int err;

    err = bt_enable(NULL);
    if (err)
    {
        printk("Bluetooth init failed (err %d)\n", err);
        return;
    }

    bt_ready();

    bt_conn_auth_cb_register(&auth_cb_display);

    int16_t error = 0;

    sensirion_i2c_hal_init();

    error = svm41_device_reset();
    if (error)
    {
        printf("Error executing svm41_device_reset(): %i\n", error);
    }

    unsigned char serial_number[26];
    uint8_t serial_number_size = 26;
    error = svm41_get_serial_number(serial_number, serial_number_size);
    if (error)
    {
        printf("Error executing svm41_get_serial_number(): %i\n", error);
    }
    else
    {
        printf("Serial number: %s\n", serial_number);
    }

    uint8_t firmware_major;
    uint8_t firmware_minor;
    bool firmware_debug;
    uint8_t hardware_major;
    uint8_t hardware_minor;
    uint8_t protocol_major;
    uint8_t protocol_minor;
    error = svm41_get_version(&firmware_major, &firmware_minor, &firmware_debug,
                              &hardware_major, &hardware_minor, &protocol_major,
                              &protocol_minor);

    if (error)
    {
        printf("Error executing svm41_get_version(): %i\n", error);
    }
    else
    {
        printf("Firmware: %i.%i Debug: %i\n", firmware_major, firmware_minor,
               firmware_debug);
        printf("Hardware: %i.%i\n", hardware_major, hardware_minor);
        printf("Protocol: %i.%i\n", protocol_major, protocol_minor);
    }

    int16_t t_offset;
    error = svm41_get_temperature_offset_for_rht_measurements(&t_offset);
    if (error)
    {
        printf("Error executing "
               "svm41_get_temperature_offset_for_rht_measurements(): %i\n",
               error);
    }
    else
    {
        printf("Temperature Offset: %i ticks\n", t_offset);
    }

    // Start Measurement
    error = svm41_start_measurement();
    if (error)
    {
        printf("Error executing svm41_start_measurement(): %i\n", error);
    }

    for (;;)
    {
        // Read Measurement
        sensirion_i2c_hal_sleep_usec(10000000); // Delay 10s
        int16_t humidity;
        int16_t temperature;
        int16_t voc_index;
        int16_t nox_index;
        int16_t fire;
        error = svm41_read_measured_values_as_integers(&humidity, &temperature,
                                                       &voc_index, &nox_index);
        if (error)
        {
            printf("Error executing svm41_read_measured_values_as_integers(): "
                   "%i\n",
                   error);
        }
        else
        {
            printf("Humidity: %i milli %% RH\n", humidity * 10);
            printf("Temperature: %i milli °C\n", (temperature >> 1) * 10);
            printf("VOC index: %i (index * 10)\n", voc_index);
            printf("NOx index: %i (index * 10)\n", nox_index);

            if (((temperature >> 1) / 100)>65 && humidity<40 && voc_index>2000){
                fire = 1;
            }else{
                fire = 0;
            }

            temp_indicate((temperature >> 1) / 100);
            hum_indicate((humidity)/100);
            voc_indicate(voc_index);
            nox_indicate(nox_index);
            fire_indicate(fire);

            
            /* Battery level simulation */
            bas_notify();
        }
        k_sleep(K_SECONDS(1));
    }

    error = svm41_stop_measurement();

    if (error)
    {
        printf("Error executing svm41_stop_measurement(): %i\n", error);
    }

    return 0;
}
```

## src/fire.c
```c
/** @file
 *  @brief HTS Service sample
 */

/*
 * Copyright (c) 2020 SixOctets Systems
 * Copyright (c) 2019 Aaron Tsui <aaron.tsui@outlook.com>
 *
 * SPDX-License-Identifier: Apache-2.0
 */

#include <stdio.h>
#include <stddef.h>
#include <string.h>
#include <errno.h>

#include <zephyr/kernel.h>
#include <zephyr/drivers/sensor.h>
#include <zephyr/sys/printk.h>
#include <zephyr/sys/byteorder.h>

#include <zephyr/bluetooth/bluetooth.h>
#include <zephyr/bluetooth/hci.h>
#include <zephyr/bluetooth/conn.h>
#include <zephyr/bluetooth/uuid.h>
#include <zephyr/bluetooth/gatt.h>


#ifdef CONFIG_TEMP_NRF5
static const struct device *temp_dev = DEVICE_DT_GET_ANY(nordic_nrf_temp);
#else
static const struct device *fire_dev;
#endif

static uint8_t simulate_fire;
static uint8_t indicating_fire;
static struct bt_gatt_indicate_params ind_params_fire;

static void htmc_ccc_cfg_changed(const struct bt_gatt_attr *attr,
				 uint16_t value)
{
	simulate_fire = (value == BT_GATT_CCC_INDICATE) ? 1 : 0;
}

static void indicate_cb(struct bt_conn *conn,
			struct bt_gatt_indicate_params *params, uint8_t err)
{
	printk("Indication %s\n", err != 0U ? "fail" : "success");
}

static void indicate_destroy(struct bt_gatt_indicate_params *params)
{
	printk("Indication complete\n");
	indicating_fire = 0U;
}

/* Temperature Service Declaration */
BT_GATT_SERVICE_DEFINE(fire_svc,
	BT_GATT_PRIMARY_SERVICE(BT_UUID_HTS),
	BT_GATT_CHARACTERISTIC(BT_UUID_DIS_SOFTWARE_REVISION, BT_GATT_CHRC_INDICATE,
			       BT_GATT_PERM_NONE, NULL, NULL, NULL),
	BT_GATT_CCC(htmc_ccc_cfg_changed,
		    BT_GATT_PERM_READ | BT_GATT_PERM_WRITE),
	/* more optional Characteristics */
);

void fire_init(void)
{
	if (fire_dev == NULL || !device_is_ready(fire_dev)) {
		printk("no temperature device; using simulated data\n");
		fire_dev = NULL;
	} else {
		printk("temp device is %p, name is %s\n", fire_dev,
		       fire_dev->name);
	}
}

void fire_indicate(int16_t fire)
{
	/* Temperature measurements simulation */
	struct sensor_value fire_value;

	if (simulate_fire) {
		static uint8_t htm[10];
		//static double temperature = 20U;
		uint32_t mantissa;
		uint8_t exponent;
		int r;

		if (indicating_fire) {
			return;
		}

		if (!fire_dev) {
			/*temperature++;
			if (temperature == 30U) {
				temperature = 20U;
			}
*/
			goto gatt_indicate;
		}

		r = sensor_sample_fetch(fire_dev);
		if (r) {
			printk("sensor_sample_fetch failed return: %d\n", r);
		}

		r = sensor_channel_get(fire_dev, SENSOR_CHAN_DIE_TEMP,
				       &fire_value);
		if (r) {
			printk("sensor_channel_get failed return: %d\n", r);
		}

		//temperature = sensor_value_to_double(&temp_value);
		

gatt_indicate:
		printf("fire is %d\n", fire);
		
		char buffer[32];
		const char *str;
		if (fire == 1){
			sprintf(buffer, "FIRE!");
		}else{
			sprintf(buffer, "OK");
		}
		
		str = buffer;
		uint8_t message_length = strlen(str);
		//mantissa = (uint32_t)(voc * 100);
		//exponent = (uint8_t)-2;

		htm[0] = message_length; /* temperature in celsius */
		memcpy(&htm[1], str, message_length);

		ind_params_fire.attr = &fire_svc.attrs[2];
		ind_params_fire.func = indicate_cb;
		ind_params_fire.destroy = indicate_destroy;
		ind_params_fire.data = &htm;
		ind_params_fire.len = sizeof(htm);

		if (bt_gatt_indicate(NULL, &ind_params_fire) == 0) {
			indicating_fire = 1;
		}
	}
}
```

## src/fire.h
```c
/** @file
 *  @brief HTS Service sample
 */

/*
 * Copyright (c) 2019 Aaron Tsui <aaron.tsui@outlook.com>
 *
 * SPDX-License-Identifier: Apache-2.0
 */

#ifdef __cplusplus
extern "C" {
#endif

//void temp_init(void);
//void temp_indicate(int16_t temperature);
void fire_init(void);
void fire_indicate(int16_t fire);

#ifdef __cplusplus
}
#endif
```

## src/hum.c
```c
/** @file
 *  @brief HTS Service sample
 */

/*
 * Copyright (c) 2020 SixOctets Systems
 * Copyright (c) 2019 Aaron Tsui <aaron.tsui@outlook.com>
 *
 * SPDX-License-Identifier: Apache-2.0
 */

#include <stdio.h>
#include <stddef.h>
#include <string.h>
#include <errno.h>

#include <zephyr/kernel.h>
#include <zephyr/drivers/sensor.h>
#include <zephyr/sys/printk.h>
#include <zephyr/sys/byteorder.h>

#include <zephyr/bluetooth/bluetooth.h>
#include <zephyr/bluetooth/hci.h>
#include <zephyr/bluetooth/conn.h>
#include <zephyr/bluetooth/uuid.h>
#include <zephyr/bluetooth/gatt.h>


#ifdef CONFIG_TEMP_NRF5
static const struct device *hum_dev = DEVICE_DT_GET_ANY(nordic_nrf_temp);
#else
static const struct device *hum_dev;
#endif

static uint8_t simulate_hum;
static uint8_t indicating_hum;
static struct bt_gatt_indicate_params ind_params_hum;

static void htmc_ccc_cfg_changed(const struct bt_gatt_attr *attr,
				 uint16_t value)
{
	simulate_hum = (value == BT_GATT_CCC_INDICATE) ? 1 : 0;
}

static void indicate_cb(struct bt_conn *conn,
			struct bt_gatt_indicate_params *params, uint8_t err)
{
	printk("Indication %s\n", err != 0U ? "fail" : "success");
}

static void indicate_destroy(struct bt_gatt_indicate_params *params)
{
	printk("Indication complete\n");
	indicating_hum= 0U;
}

/* Temperature Service Declaration */
BT_GATT_SERVICE_DEFINE(hum_svc,
	BT_GATT_PRIMARY_SERVICE(BT_UUID_HUMIDITY),
	BT_GATT_CHARACTERISTIC(BT_UUID_HUMIDITY, BT_GATT_CHRC_INDICATE,
			       BT_GATT_PERM_NONE, NULL, NULL, NULL),
	BT_GATT_CCC(htmc_ccc_cfg_changed,
		    BT_GATT_PERM_READ | BT_GATT_PERM_WRITE),
	/* more optional Characteristics */
);

void hum_init(void)
{
	if (hum_dev == NULL || !device_is_ready(hum_dev)) {
		printk("no temperature device; using simulated data\n");
		hum_dev = NULL;
	} else {
		printk("hum device is %p, name is %s\n", hum_dev,
		       hum_dev->name);
	}
}

void hum_indicate(int16_t humidity)
{
	/* Temperature measurements simulation */
	struct sensor_value temp_value;

	if (simulate_hum) {
		static uint8_t htm[5];
		//static double temperature = 20U;
		uint32_t mantissa;
		uint8_t exponent;
		int r;

		if (indicating_hum) {
			return;
		}

		if (!hum_dev) {
			goto gatt_indicate;
		}

		r = sensor_sample_fetch(hum_dev);
		if (r) {
			printk("sensor_sample_fetch failed return: %d\n", r);
		}

		r = sensor_channel_get(hum_dev, SENSOR_CHAN_DIE_TEMP,
				       &temp_value);
		if (r) {
			printk("sensor_channel_get failed return: %d\n", r);
		}

		//temperature = sensor_value_to_double(&temp_value);
		

gatt_indicate:
		printf("temperature is %fC\n", humidity);
		
		mantissa = (uint32_t)(humidity * 100);
		exponent = (uint8_t)-2;

		htm[0] = 0; /* temperature in celsius */
		sys_put_le24(mantissa, (uint8_t *)&htm[1]);
		htm[4] = exponent;

		ind_params_hum.attr = &hum_svc.attrs[2];
		ind_params_hum.func = indicate_cb;
		ind_params_hum.destroy = indicate_destroy;
		ind_params_hum.data = &htm;
		ind_params_hum.len = sizeof(htm);

		if (bt_gatt_indicate(NULL, &ind_params_hum) == 0) {
			indicating_hum = 1;
		}
	}
}
```

## src/hum.h
```c
/** @file
 *  @brief HTS Service sample
 */

/*
 * Copyright (c) 2019 Aaron Tsui <aaron.tsui@outlook.com>
 *
 * SPDX-License-Identifier: Apache-2.0
 */

#ifdef __cplusplus
extern "C" {
#endif

void hum_init(void);
void hum_indicate(int16_t humidity);

#ifdef __cplusplus
}
#endif
```

## src/nox.c
```c
/** @file
 *  @brief HTS Service sample
 */

/*
 * Copyright (c) 2020 SixOctets Systems
 * Copyright (c) 2019 Aaron Tsui <aaron.tsui@outlook.com>
 *
 * SPDX-License-Identifier: Apache-2.0
 */

#include <stdio.h>
#include <stddef.h>
#include <string.h>
#include <errno.h>

#include <zephyr/kernel.h>
#include <zephyr/drivers/sensor.h>
#include <zephyr/sys/printk.h>
#include <zephyr/sys/byteorder.h>

#include <zephyr/bluetooth/bluetooth.h>
#include <zephyr/bluetooth/hci.h>
#include <zephyr/bluetooth/conn.h>
#include <zephyr/bluetooth/uuid.h>
#include <zephyr/bluetooth/gatt.h>


#ifdef CONFIG_TEMP_NRF5
static const struct device *temp_dev = DEVICE_DT_GET_ANY(nordic_nrf_temp);
#else
static const struct device *nox_dev;
#endif

static uint8_t simulate_nox;
static uint8_t indicating_nox;
static struct bt_gatt_indicate_params ind_params_nox;

static void htmc_ccc_cfg_changed(const struct bt_gatt_attr *attr,
				 uint16_t value)
{
	simulate_nox = (value == BT_GATT_CCC_INDICATE) ? 1 : 0;
}

static void indicate_cb(struct bt_conn *conn,
			struct bt_gatt_indicate_params *params, uint8_t err)
{
	printk("Indication %s\n", err != 0U ? "fail" : "success");
}

static void indicate_destroy(struct bt_gatt_indicate_params *params)
{
	printk("Indication complete\n");
	indicating_nox = 0U;
}

/* Temperature Service Declaration */
BT_GATT_SERVICE_DEFINE(nox_svc,
	BT_GATT_PRIMARY_SERVICE(BT_UUID_HTS),
	BT_GATT_CHARACTERISTIC(BT_UUID_DIS_SOFTWARE_REVISION, BT_GATT_CHRC_INDICATE,
			       BT_GATT_PERM_NONE, NULL, NULL, NULL),
	BT_GATT_CCC(htmc_ccc_cfg_changed,
		    BT_GATT_PERM_READ | BT_GATT_PERM_WRITE),
	/* more optional Characteristics */
);

void nox_init(void)
{
	if (nox_dev == NULL || !device_is_ready(nox_dev)) {
		printk("no temperature device; using simulated data\n");
		nox_dev = NULL;
	} else {
		printk("temp device is %p, name is %s\n", nox_dev,
		       nox_dev->name);
	}
}

void nox_indicate(int16_t nox)
{
	/* Temperature measurements simulation */
	struct sensor_value nox_value;

	if (simulate_nox) {
		static uint8_t htm[10];
		//static double temperature = 20U;
		uint32_t mantissa;
		uint8_t exponent;
		int r;

		if (indicating_nox) {
			return;
		}

		if (!nox_dev) {
			/*temperature++;
			if (temperature == 30U) {
				temperature = 20U;
			}
*/
			goto gatt_indicate;
		}

		r = sensor_sample_fetch(nox_dev);
		if (r) {
			printk("sensor_sample_fetch failed return: %d\n", r);
		}

		r = sensor_channel_get(nox_dev, SENSOR_CHAN_DIE_TEMP,
				       &nox_value);
		if (r) {
			printk("sensor_channel_get failed return: %d\n", r);
		}

		//temperature = sensor_value_to_double(&temp_value);
		

gatt_indicate:
		printf("NOX is %fC\n", nox);
		
		char buffer[32];
		const char *str;
		sprintf(buffer, "Nox: %d", nox);
		str = buffer;
		uint8_t message_length = strlen(str);
		//mantissa = (uint32_t)(voc * 100);
		//exponent = (uint8_t)-2;

		htm[0] = message_length; /* temperature in celsius */
		memcpy(&htm[1], str, message_length);

		ind_params_nox.attr = &nox_svc.attrs[2];
		ind_params_nox.func = indicate_cb;
		ind_params_nox.destroy = indicate_destroy;
		ind_params_nox.data = &htm;
		ind_params_nox.len = sizeof(htm);

		if (bt_gatt_indicate(NULL, &ind_params_nox) == 0) {
			indicating_nox = 1;
		}
	}
}
```

## src/nox.h
```c
/** @file
 *  @brief HTS Service sample
 */

/*
 * Copyright (c) 2019 Aaron Tsui <aaron.tsui@outlook.com>
 *
 * SPDX-License-Identifier: Apache-2.0
 */

#ifdef __cplusplus
extern "C" {
#endif

//void temp_init(void);
//void temp_indicate(int16_t temperature);
void nox_init(void);
void nox_indicate(int16_t nox);

#ifdef __cplusplus
}
#endif
```

## src/temp.c
```c
/** @file
 *  @brief HTS Service sample
 */

/*
 * Copyright (c) 2020 SixOctets Systems
 * Copyright (c) 2019 Aaron Tsui <aaron.tsui@outlook.com>
 *
 * SPDX-License-Identifier: Apache-2.0
 */

#include <stdio.h>
#include <stddef.h>
#include <string.h>
#include <errno.h>

#include <zephyr/kernel.h>
#include <zephyr/drivers/sensor.h>
#include <zephyr/sys/printk.h>
#include <zephyr/sys/byteorder.h>

#include <zephyr/bluetooth/bluetooth.h>
#include <zephyr/bluetooth/hci.h>
#include <zephyr/bluetooth/conn.h>
#include <zephyr/bluetooth/uuid.h>
#include <zephyr/bluetooth/gatt.h>

#define TEMP_SERVICE_UUID				0x01, 0x55, 0xBB, 0xDE, 0x5E, 0xCA, 0x78, 0xA1, 0x8E, 0xA2, 0x01, 0x10, 0x40, 0xEC, 0x07, 0xB1
#define COMMAND_CHARACTERISTIC_UUID		0x01, 0x00, 0xBB, 0xDE, 0x5E, 0xCA, 0x78, 0xA1, 0x8E, 0xA2, 0x01, 0x10, 0x40, 0xEC, 0x07, 0xB1
#define DATA_CHARACTERISTIC_UUID 		0x00, 0x00, 0xBB, 0xDE, 0x5E, 0xCA, 0x78, 0xA1, 0x8E, 0xA2, 0x01, 0x10, 0x40, 0xEC, 0x07, 0xB1

#ifdef CONFIG_TEMP_NRF5
static const struct device *temp_dev = DEVICE_DT_GET_ANY(nordic_nrf_temp);
#else
static const struct device *temp_dev;
#endif

static uint8_t simulate_temp;
static uint8_t indicating_temp;
static struct bt_gatt_indicate_params ind_params_temp;

static void htmc_ccc_cfg_changed(const struct bt_gatt_attr *attr,
				 uint16_t value)
{
	simulate_temp = (value == BT_GATT_CCC_INDICATE) ? 1 : 0;
}

static void indicate_cb(struct bt_conn *conn,
			struct bt_gatt_indicate_params *params, uint8_t err)
{
	printk("Indication %s\n", err != 0U ? "fail" : "success");
}

static void indicate_destroy(struct bt_gatt_indicate_params *params)
{
	printk("Indication complete\n");
	indicating_temp = 0U;
}

/* Temperature Service Declaration */
BT_GATT_SERVICE_DEFINE(temp_svc,
	BT_GATT_PRIMARY_SERVICE(BT_UUID_HTS),
	BT_GATT_CHARACTERISTIC(BT_UUID_DIS_SOFTWARE_REVISION, BT_GATT_CHRC_INDICATE,
			       BT_GATT_PERM_NONE, NULL, NULL, NULL),
	BT_GATT_CCC(htmc_ccc_cfg_changed,
		    BT_GATT_PERM_READ | BT_GATT_PERM_WRITE),
	/* more optional Characteristics */
);

void temp_init(void)
{
	if (temp_dev == NULL || !device_is_ready(temp_dev)) {
		printk("no temperature device; using simulated data\n");
		temp_dev = NULL;
	} else {
		printk("temp device is %p, name is %s\n", temp_dev,
		       temp_dev->name);
	}
}

void temp_indicate(int16_t temperature)
{
	/* Temperature measurements simulation */
	struct sensor_value temp_value;

	if (simulate_temp) {
		static uint8_t htm[10];
		//static double temperature = 20U;
		uint32_t mantissa;
		uint8_t exponent;
		int r;

		if (indicating_temp) {
			return;
		}

		if (!temp_dev) {
			/*temperature++;
			if (temperature == 30U) {
				temperature = 20U;
			}
*/
			goto gatt_indicate;
		}

		r = sensor_sample_fetch(temp_dev);
		if (r) {
			printk("sensor_sample_fetch failed return: %d\n", r);
		}

		r = sensor_channel_get(temp_dev, SENSOR_CHAN_DIE_TEMP,
				       &temp_value);
		if (r) {
			printk("sensor_channel_get failed return: %d\n", r);
		}

		//temperature = sensor_value_to_double(&temp_value);
		

gatt_indicate:
		printf("temperature is %fC\n", temperature);
		
		char buffer[32];
		const char *str;
		sprintf(buffer, "Temp: %dC", temperature);
		str = buffer;
		uint8_t message_length = strlen(str);
		//mantissa = (uint32_t)(voc * 100);
		//exponent = (uint8_t)-2;

		htm[0] = message_length; /* temperature in celsius */
		memcpy(&htm[1], str, message_length);

		ind_params_temp.attr = &temp_svc.attrs[2];
		ind_params_temp.func = indicate_cb;
		ind_params_temp.destroy = indicate_destroy;
		ind_params_temp.data = &htm;
		ind_params_temp.len = sizeof(htm);

		if (bt_gatt_indicate(NULL, &ind_params_temp) == 0) {
			indicating_temp = 1;
		}
	}
}
```

## src/temp.h
```c
/** @file
 *  @brief HTS Service sample
 */

/*
 * Copyright (c) 2019 Aaron Tsui <aaron.tsui@outlook.com>
 *
 * SPDX-License-Identifier: Apache-2.0
 */

#ifdef __cplusplus
extern "C" {
#endif

void temp_init(void);
void temp_indicate(int16_t temperature);
void hum_init(void);
void hum_indicate(void);

#ifdef __cplusplus
}
#endif
```

## src/voc.c
```c
/** @file
 *  @brief HTS Service sample
 */

/*
 * Copyright (c) 2020 SixOctets Systems
 * Copyright (c) 2019 Aaron Tsui <aaron.tsui@outlook.com>
 *
 * SPDX-License-Identifier: Apache-2.0
 */

#include <stdio.h>
#include <stddef.h>
#include <string.h>
#include <errno.h>

#include <zephyr/kernel.h>
#include <zephyr/drivers/sensor.h>
#include <zephyr/sys/printk.h>
#include <zephyr/sys/byteorder.h>

#include <zephyr/bluetooth/bluetooth.h>
#include <zephyr/bluetooth/hci.h>
#include <zephyr/bluetooth/conn.h>
#include <zephyr/bluetooth/uuid.h>
#include <zephyr/bluetooth/gatt.h>


#ifdef CONFIG_TEMP_NRF5
static const struct device *voc_dev = DEVICE_DT_GET_ANY(nordic_nrf_temp);
#else
static const struct device *voc_dev;
#endif

static uint8_t simulate_voc;
static uint8_t indicating_voc;
static struct bt_gatt_indicate_params ind_params_voc;

static void htmc_ccc_cfg_changed(const struct bt_gatt_attr *attr,
				 uint16_t value)
{
	simulate_voc = (value == BT_GATT_CCC_INDICATE) ? 1 : 0;
}

static void indicate_cb(struct bt_conn *conn,
			struct bt_gatt_indicate_params *params, uint8_t err)
{
	printk("Indication %s\n", err != 0U ? "fail" : "success");
}

static void indicate_destroy(struct bt_gatt_indicate_params *params)
{
	printk("Indication complete\n");
	indicating_voc = 0U;
}

/* Temperature Service Declaration */
BT_GATT_SERVICE_DEFINE(voc_svc,
	BT_GATT_PRIMARY_SERVICE(BT_UUID_HTS),
	BT_GATT_CHARACTERISTIC(BT_UUID_DIS_SOFTWARE_REVISION, BT_GATT_CHRC_INDICATE,
			       BT_GATT_PERM_NONE, NULL, NULL, NULL),
	BT_GATT_CCC(htmc_ccc_cfg_changed,
		    BT_GATT_PERM_READ | BT_GATT_PERM_WRITE),
	/* more optional Characteristics */
);

void voc_init(void)
{
	if (voc_dev == NULL || !device_is_ready(voc_dev)) {
		printk("no temperature device; using simulated data\n");
		voc_dev = NULL;
	} else {
		printk("temp device is %p, name is %s\n", voc_dev,
		       voc_dev->name);
	}
}

void voc_indicate(int16_t voc)
{
	/* Temperature measurements simulation */
	struct sensor_value voc_value;

	if (simulate_voc) {
		static uint16_t htm[10];
		//static double temperature = 20U;
		uint32_t mantissa;
		uint8_t exponent;
		int r;

		if (indicating_voc) {
			return;
		}

		if (!voc_dev) {
			/*temperature++;
			if (temperature == 30U) {
				temperature = 20U;
			}
*/
			goto gatt_indicate;
		}

		r = sensor_sample_fetch(voc_dev);
		if (r) {
			printk("sensor_sample_fetch failed return: %d\n", r);
		}

		r = sensor_channel_get(voc_dev, SENSOR_CHAN_DIE_TEMP,
				       &voc_value);
		if (r) {
			printk("sensor_channel_get failed return: %d\n", r);
		}

		//temperature = sensor_value_to_double(&temp_value);
		
gatt_indicate:
		printf("VOC is %dC\n", voc);
		char buffer[32];
		const char *str;
		sprintf(buffer, "Voc: %d", voc);
		str = buffer;
		uint8_t message_length = strlen(str);
		//mantissa = (uint32_t)(voc * 100);
		//exponent = (uint8_t)-2;

		htm[0] = message_length; /* temperature in celsius */
		memcpy(&htm[1], str, message_length);
		//sys_put_le24(mantissa, (uint8_t *)&htm[1]);
		//htm[7] = exponent;

		ind_params_voc.attr = &voc_svc.attrs[2];
		ind_params_voc.func = indicate_cb;
		ind_params_voc.destroy = indicate_destroy;
		ind_params_voc.data = (void *)&htm;
		ind_params_voc.len = sizeof(htm);

		if (bt_gatt_indicate(NULL, &ind_params_voc) == 0) {
			indicating_voc = 1;
		}
	}
}
```

## src/voc.h
```c
/** @file
 *  @brief HTS Service sample
 */

/*
 * Copyright (c) 2019 Aaron Tsui <aaron.tsui@outlook.com>
 *
 * SPDX-License-Identifier: Apache-2.0
 */

#ifdef __cplusplus
extern "C" {
#endif

void voc_init(void);
void voc_indicate(int16_t voc);

#ifdef __cplusplus
}
#endif
```
